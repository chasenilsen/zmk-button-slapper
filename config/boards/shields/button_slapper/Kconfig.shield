## config/boards/shields/button_slapper/Kconfig.shield
```kconfig
config SHIELD_BUTTON_SLAPPER_LEFT
    def_bool $(shields_list_contains,button_slapper_left)

config SHIELD_BUTTON_SLAPPER_RIGHT
    def_bool $(shields_list_contains,button_slapper_right)
```
